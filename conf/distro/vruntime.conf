## conf/distro/vruntime.conf
```bitbake
# SPDX-FileCopyrightText: Copyright (C) 2025 Bruce Ashfield
#
# SPDX-License-Identifier: MIT
#
# VRuntime - Minimal distro for vdkr/vpdmn container runtime environments
#
# This distro is used by multiconfig builds (vruntime-aarch64, vruntime-x86-64)
# to create minimal rootfs images for QEMU-based container processing.
#
# The resulting images contain Docker or Podman tools and are used by
# vrunner.sh to import containers during Yocto image builds.

require conf/distro/poky.conf

DISTRO = "vruntime"
DISTRO_NAME = "VRuntime Minimal"
DISTRO_VERSION = "1.0"

# Minimal distro features for container runtime environment
# - acl: Access control lists (containers need this)
# - ext2: Filesystem support
# - ipv4/ipv6: Network support for container networking
# - seccomp: Security for container isolation
# - vfat: For potential boot partition support
# - pci: PCI device support (virtio devices)
# - vcontainer: Enable vdkr/vpdmn kernel config fragments (9p, squashfs, overlayfs)
#
# Explicitly NOT included: x11, wayland, pulseaudio, bluetooth, wifi, nfc, 3g, pcmcia
DISTRO_FEATURES = "acl ext2 ipv4 ipv6 seccomp vfat pci vcontainer"

# Native and nativesdk classes need full features for build tools
DISTRO_FEATURES:class-native = "${DISTRO_FEATURES_DEFAULT} ${POKY_DEFAULT_DISTRO_FEATURES}"
DISTRO_FEATURES:class-nativesdk = "${DISTRO_FEATURES_DEFAULT} ${POKY_DEFAULT_DISTRO_FEATURES}"

# Default to ext4, but image recipes may override to squashfs
IMAGE_FSTYPES = "ext4"

# Use busybox init for minimal footprint
# The vdkr/vpdmn images use custom /init scripts anyway
VIRTUAL-RUNTIME_init_manager = "busybox"
VIRTUAL-RUNTIME_initscripts = "initscripts"

# Disable unnecessary features
VIRTUAL-RUNTIME_login_manager = ""

# Keep images small - no documentation or debug
EXTRA_IMAGE_FEATURES = ""
```

## files/wic/efi-xen-x86-64.wks
```
# short-description: Create an EFI disk image with Xen hypervisor
# long-description: Creates a GPT partitioned UEFI disk image that boots Xen
# directly via the native xen.efi EFI application.  For use with OVMF (QEMU),
# Hyper-V Gen 2 VMs, and any other UEFI firmware.
#
# The xen.efi binary is installed as bootx64.efi with a generated bootx64.cfg
# that chain-loads the dom0 kernel.  No intermediate bootloader (GRUB, etc.)
# is needed.
#
# Test with OVMF:
#   runqemu xen-image-minimal wic nographic slirp kvm ovmf qemuparams="-m 4096"
#
# Convert to VHDX for Hyper-V:
#   qemu-img convert -f raw -O vhdx xen-image-minimal-*.wic xen-image-minimal.vhdx

part /boot --source bootimg-efixen --ondisk sda --label boot --active --align 1024

# Rootfs partition -- add --size 10G or larger for VM storage
part / --source rootfs --ondisk sda --use-uuid --fstype=ext4 --label root --align 1024

bootloader --ptable gpt --timeout=5 --append="dom0_mem=512M console=com1,vga com1=115200,8n1 loglvl=all guest_loglvl=all --- console=hvc0 earlyprintk=xen root=/dev/sda2 rootwait pmtmr=0"
```
